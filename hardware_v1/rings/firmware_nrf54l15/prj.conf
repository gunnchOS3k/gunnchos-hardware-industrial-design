## CMakeLists.txt
```
cmake_minimum_required(VERSION 3.20.0)
find_package(Zephyr REQUIRED HINTS $ENV{ZEPHYR_BASE})
project(rings_nrf54l15)
target_sources(app PRIVATE src/main.c src/ble_ring.c src/imu_haptic.c)
```

## prj.conf
```kconfig
CONFIG_BT=y
CONFIG_BT_PERIPHERAL=y
CONFIG_BOOTLOADER_MCUBOOT=y
CONFIG_GPIO=y
CONFIG_I2C=y
CONFIG_SENSOR=y
CONFIG_LOG=y
```

## boards/gunnchos_ring_nrf54l15.overlay
```dts
/ {
    aliases {
        imu = &i2c0;
    };
};
/* Pin-accurate overlay requires final pinmux from EVT schematic freeze */
```

## src/main.c
```c
#include <zephyr/kernel.h>
#include <zephyr/logging/log.h>
LOG_MODULE_REGISTER(rings_main, LOG_LEVEL_INF);

extern int rings_ble_start(void);
extern int rings_imu_haptic_init(void);

int main(void)
{
        LOG_INF("gunnchOS rings nRF54L15 digital stub");
        (void)rings_imu_haptic_init();
        (void)rings_ble_start();
        while (1) {
                k_sleep(K_SECONDS(1));
        }
        return 0;
}
```

## src/ble_ring.c
```c
#include <zephyr/kernel.h>
int rings_ble_start(void)
{
        /* Pairing ceremony hooks → ring_input authenticated protocol */
        return 0;
}
```

## src/imu_haptic.c
```c
#include <zephyr/kernel.h>
int rings_imu_haptic_init(void)
{
        /* IMU ≠ absolute pose — spatial input role preserved */
        return 0;
}
```
